## config/boards/shields/ahhboard/Kconfig.defconfig
```kconfig
if SHIELD_AHHBOARD_LEFT

config ZMK_KEYBOARD_NAME
    default "ahhboard"

config ZMK_SPLIT_ROLE_CENTRAL
    default y

endif

if SHIELD_AHHBOARD_LEFT || SHIELD_AHHBOARD_RIGHT

config ZMK_SPLIT
    default y

endif
```

## config/boards/shields/ahhboard/Kconfig.shield
```kconfig
config SHIELD_AHHBOARD_LEFT
    def_bool $(shields_list_contains, ahhboard_left)

config SHIELD_AHHBOARD_RIGHT
    def_bool $(shields_list_contains, ahhboard_right)
```
